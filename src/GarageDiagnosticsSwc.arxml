AUTOSAR XML (schema 4-2-1)
ar packages iCalibrate
  operations calibrateStraightAhead
    arg action: type=tCalibrateCmd, direction=IN
    arg calibrated: type=Boolean, direction=OUT
    arg status: type=tCalibrateState, direction=OUT
