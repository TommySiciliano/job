[part 1 of 2: packages /FoundationPkg/FoundationArchitecturePkg to /GeneralMotorsPkg/GeneralMotorsArchitecturePkg]
AUTOSAR XML (schema 4-2-1)
standard types defined: float32, float64, sint8, sint16, sint32, uint8, uint16, uint32, boolean, dtRef_VOID, Boolean, Float32, UInt8, UInt32, UInt16
package /FoundationPkg/FoundationArchitecturePkg
  client server interface iCalibrate
    operation calibrateStraightAhead
      arg action: type=tCalibrateCmd, direction=IN
    operation isStraightAheadCalibrated
      arg calibrated: type=Boolean, direction=OUT
    operation getCalibrateStatus
      arg status: type=tCalibrateState, direction=OUT
  constant specification iRawVehicleSpeed_VehicleSpeed_Init: value-spec={short-label=iRawVehicleSpeed_VehicleSpeed_Init, fields=[0 Kph, 0]}
  sender receiver interface iRawVehicleSpeed
    data VehicleSpeed: sw-calibration-access=READ-ONLY, type=tRawVehicleSpeed, init-value=constant-reference=iRawVehicleSpeed_VehicleSpeed_Init
  13 x constant specification, all with value-spec=1:
    iCoreFeaturesEnabled_DisturbanceRejectionEnabled_Init
    iCoreFeaturesEnabled_DriverSteeringRecommendationEnabled_Init
    iCoreFeaturesEnabled_FrictionCompensationEnabled_Init
    iCoreFeaturesEnabled_HapticVibrationGeneratorEnabled_Init
    iCoreFeaturesEnabled_LaneKeepingAssistEnabled_Init
    iCoreFeaturesEnabled_ParkAssistEnabled_Init
    iCoreFeaturesEnabled_PullDriftCompensationEnabled_Init
    iCoreFeaturesEnabled_RackEndStopEnabled_Init
    iCoreFeaturesEnabled_RapidControlPrototypingEnabled_Init
    iCoreFeaturesEnabled_SteerFeelSelectionEnabled_Init
    iCoreFeaturesEnabled_SteeringPositionControllerEnabled_Init
    iCoreFeaturesEnabled_StartStopEnabled_Init
    iCoreFeaturesEnabled_ActiveReturnEnabled_Init
  sender receiver interface iCoreFeaturesEnabled
    13 x data, all with sw-calibration-access=READ-ONLY, type=Boolean:
      DisturbanceRejectionEnabled: init-value=constant-reference=iCoreFeaturesEnabled_DisturbanceRejectionEnabled_Init
      DriverSteeringRecommendationEnabled: init-value=constant-reference=iCoreFeaturesEnabled_DriverSteeringRecommendationEnabled_Init
      FrictionCompensationEnabled: init-value=constant-reference=iCoreFeaturesEnabled_FrictionCompensationEnabled_Init
      HapticVibrationGeneratorEnabled: init-value=constant-reference=iCoreFeaturesEnabled_HapticVibrationGeneratorEnabled_Init
      LaneKeepingAssistEnabled: init-value=constant-reference=iCoreFeaturesEnabled_LaneKeepingAssistEnabled_Init
      ParkAssistEnabled: init-value=constant-reference=iCoreFeaturesEnabled_ParkAssistEnabled_Init
      PullDriftCompensationEnabled: init-value=constant-reference=iCoreFeaturesEnabled_PullDriftCompensationEnabled_Init
      RackEndStopEnabled: init-value=constant-reference=iCoreFeaturesEnabled_RackEndStopEnabled_Init
      RapidControlPrototypingEnabled: init-value=constant-reference=iCoreFeaturesEnabled_RapidControlPrototypingEnabled_Init
      SteerFeelSelectionEnabled: init-value=constant-reference=iCoreFeaturesEnabled_SteerFeelSelectionEnabled_Init
      SteeringPositionControllerEnabled: init-value=constant-reference=iCoreFeaturesEnabled_SteeringPositionControllerEnabled_Init
      StartStopEnabled: init-value=constant-reference=iCoreFeaturesEnabled_StartStopEnabled_Init
      ActiveReturnEnabled: init-value=constant-reference=iCoreFeaturesEnabled_ActiveReturnEnabled_Init
  client server interface iBattery
    operation getBatteryVoltage
      arg value: type=Volts, direction=OUT
      arg qf: type=tQualityFactor, direction=OUT
    operation getBatteryCurrent
      arg value: type=Amps, direction=OUT
      arg qf: type=tQualityFactor, direction=OUT
  6 x constant specification:
    iColumnData_ColumnTorque_Init: value-spec={short-label=iColumnData_ColumnTorque_Init, fields=[0 Nm, 0 Nm/s, 0, {short-label=tInputTorque_EQf_Init, fields=[1, 1, 1, 1]}]}
    iColumnData_SteeringPositionLower_Init: value-spec={short-label=iColumnData_SteeringPositionLower_Init, fields=[0 deg, 0, {short-label=tColumnPosition_EQf_Init, fields=[1, 1, 1, 1]}]}
    iColumnData_ColumnVelocity_Init: value-spec={short-label=iColumnData_ColumnVelocity_Init, fields=[0 revs/S, 0 revs/S, 0]}
    iColumnData_SteeringPositionUpper_Init: value-spec={short-label=iColumnData_SteeringPositionUpper_Init, fields=[0 deg, 0, {short-label=tColumnPosition_EQf_Init, fields=[1, 1, 1, 1]}]}
    iColumnData_ColumnPositionLower_Init: value-spec={short-label=iColumnData_ColumnPositionLower_Init, fields=[0 deg, 0, {short-label=tColumnPosition_EQf_Init, fields=[1, 1, 1, 1]}]}
    iColumnData_SteeringPositionCorrection_Init: value-spec={short-label=iColumnData_SteeringPositionCorrection_Init, fields=[0 deg, 0, {short-label=tColumnPosition_EQf_Init, fields=[1, 1, 1, 1]}]}
  sender receiver interface iColumnData
    6 x data, all with sw-calibration-access=READ-ONLY:
      ColumnTorque: type=tInputTorque, init-value=constant-reference=iColumnData_ColumnTorque_Init
      SteeringPositionLower: type=tColumnPosition, init-value=constant-reference=iColumnData_SteeringPositionLower_Init
      ColumnVelocity: type=tColumnVelocity, init-value=constant-reference=iColumnData_ColumnVelocity_Init
      SteeringPositionUpper: type=tColumnPosition, init-value=constant-reference=iColumnData_SteeringPositionUpper_Init
      ColumnPositionLower: type=tColumnPosition, init-value=constant-reference=iColumnData_ColumnPositionLower_Init
      SteeringPositionCorrection: type=tColumnPosition, init-value=constant-reference=iColumnData_SteeringPositionCorrection_Init
  constant specification iVehicleData_VehicleSpeed_Init: value-spec={short-label=iVehicleData_VehicleSpeed_Init, fields=[0 Kph, 0, 0]}
  constant specification iVehicleData_EstimatedSteeringPosition_Init: value-spec={short-label=iVehicleData_EstimatedSteeringPosition_Init, fields=[0 deg, 0, 0 %]}
  constant specification iVehicleData_YawRate_Init: value-spec={short-label=iVehicleData_YawRate_Init, fields=[0 deg/S, 0]}
  sender receiver interface iVehicleData
    data VehicleSpeed: sw-calibration-access=READ-ONLY, type=tVehicleSpd, init-value=constant-reference=iVehicleData_VehicleSpeed_Init
    data EstimatedSteeringPosition: sw-calibration-access=READ-ONLY, type=tEstimatedSteeringPosition, init-value=constant-reference=iVehicleData_EstimatedSteeringPosition_Init
    data YawRate: sw-calibration-access=READ-ONLY, type=tYawRateData, init-value=constant-reference=iVehicleData_YawRate_Init
  client server interface iSystemTime
    operation getSystemTime
      arg systemTime: type=uSec, direction=OUT
  client server interface iTemperature
    operation getDriveStageTemperature
      arg value: type=Centigrade, direction=OUT
      arg qf: type=tQualityFactor, direction=OUT
    operation getPcbTemperature
      arg value: type=Centigrade, direction=OUT
      arg qf: type=tQualityFactor, direction=OUT
    operation getMicrocontrollerDieTemperature
      arg value: type=Centigrade, direction=OUT
      arg qf: type=tQualityFactor, direction=OUT
  constant specification iAngle_Angle_Init: value-spec={short-label=iAngle_Angle_Init, fields=[0 deg, 0]}
  sender receiver interface iAngle
    data Angle: sw-calibration-access=READ-ONLY, type=tSensorAngle, init-value=constant-reference=iAngle_Angle_Init
  constant specification iExtSignConvention_SIGN_CONVENTION_Init: value-spec=-1
  parameter interface iExtSignConvention
    parameter data prototype SIGN_CONVENTION: category=VALUE, sw-addr-method=PlatformTune, sw-calibration-access=READ-WRITE, type=tExternalSignConvention, init-value=constant-reference=iExtSignConvention_SIGN_CONVENTION_Init
  client server interface iEolNvmDataAccess
    10 x operation:
      getEcuEolTestPassed
        arg EcuEolTestPassed: type=UInt8, direction=OUT
      getEcuEolTestStatus
        arg EcuEolTestStatus: type=UInt8, direction=OUT
      getEcuPartNumber
        arg EcuPartNumber: type=tZfPartNumberData, direction=OUT
      getEppEolTestPassed
        arg EppEolTestPassed: type=UInt8, direction=OUT
      getEppEolTestStatus
        arg EppEolTestStatus: type=UInt8, direction=OUT
      getEppPartNumber
        arg EppPartNumber: type=tZfPartNumberData, direction=OUT
      getMotorPartNumber
        arg MotorPartNumber: type=tZfPartNumberData, direction=OUT
      getSystemEolTestPassed
        arg SystemEolTestPassed: type=UInt8, direction=OUT
      getSystemEolTestStatus
        arg SystemEolTestStatus: type=UInt8, direction=OUT
      getSystemPartNumber
        arg SystemPartNumber: type=tZfPartNumberData, direction=OUT
  client server interface iCgdControl
    operation resetRequest
      arg resetType: type=tEcuResetType, direction=IN
      arg response: type=UInt8, direction=OUT
    operation factoryAssistRequest
      arg response: type=UInt8, direction=OUT
  constant specification iEngineRun_EngineRun_Init: value-spec={short-label=iEngineRun_EngineRun_Init, fields=[0, 0]}
  sender receiver interface iEngineRun
    data EngineRun: sw-calibration-access=READ-ONLY, type=tEngineRun, init-value=constant-reference=iEngineRun_EngineRun_Init
  client server interface iRackCfg
    operation clearAspRangeCheckFault
    operation isRackEndStopPositionsLearned
      arg learned: type=Boolean, direction=OUT
  constant specification iAssistStates_AssistState_Init: value-spec={short-label=iAssistStates_AssistState_Init, fields=[0, 1]}
  sender receiver interface iAssistStates
    data AssistState: sw-calibration-access=READ-ONLY, type=tAssistStates, init-value=constant-reference=iAssistStates_AssistState_Init
  constant specification iExtSteerAgDmd_ExtSteerAgDmd_Init: value-spec={short-label=iExtSteerAgDmd_ExtSteerAgDmd_Init, fields=[0 deg, 0, 0, 0]}
  sender receiver interface iExtSteerAgDmd
    data ExtSteerAgDmd: sw-calibration-access=READ-ONLY, type=tExtSteerAgDmd, init-value=constant-reference=iExtSteerAgDmd_ExtSteerAgDmd_Init
  constant specification iInputTorqueDemands_OverlayTorqueDemand_Init: value-spec={short-label=iInputTorqueDemands_OverlayTorqueDemand_Init, fields=[0 Nm, 0 Nm/s, 0, {short-label=tInputTorque_EQf_Init, fields=[1, 1, 1, 1]}]}
  constant specification iInputTorqueDemands_LimitingTorqueDemand_Init: value-spec={short-label=iInputTorqueDemands_LimitingTorqueDemand_Init, fields=[0 Nm, 0]}
  sender receiver interface iInputTorqueDemands
    data OverlayTorqueDemand: sw-calibration-access=READ-ONLY, type=tInputTorque, init-value=constant-reference=iInputTorqueDemands_OverlayTorqueDemand_Init
    data LimitingTorqueDemand: sw-calibration-access=READ-ONLY, type=tAssistTorque, init-value=constant-reference=iInputTorqueDemands_LimitingTorqueDemand_Init
  client server interface iElectricDrive
    7 x operation:
      setMotorTorqueDemand
        arg torque: type=tElectricMotorTorque, direction=IN
      getMotorTorqueEstimate
        arg torque: type=tElectricMotorTorque, direction=OUT
      getMotorMechanicalPosition
        arg position: type=tMechanicalMotorPosition, direction=OUT
      getMotorMechanicalVelocity
        arg velocity: type=tMechanicalMotorVelocity, direction=OUT
      getMotorTorqueDemand
        arg torque: type=tElectricMotorTorque, direction=OUT
      setMaxMotorCurrent
        arg current: type=Amps, direction=IN
      setMaxGeneratorCurrent
        arg current: type=Amps, direction=IN
  constant specification iAssistCapability_Capability_Init: value-spec={short-label=iAssistCapability_Capability_Init, fields=[0 %, 0 %]}
  sender receiver interface iAssistCapability
    data Capability: sw-calibration-access=READ-ONLY, type=tAssistCapability, init-value=constant-reference=iAssistCapability_Capability_Init
  client server interface iNvmJobFinished: is-service=true
    operation JobFinished
      arg ServiceId: type=NvM_ServiceIdType, direction=IN
      arg JobResult: type=NvM_RequestResultType, direction=IN
package /FoundationPkg/FoundationArchitecturePkg/FoundationTypes
  impl type tCalibrateCmd: category=VALUE, base-type=sint32, compu {0=CAL_NO_COMMAND, 1=CAL_CALIBRATE, 2=CAL_ERASE}
  compu method tCalibrateState_Compu: 0=CAL_STATE_NOT_REQUESTED, 1=CAL_STATE_IN_PROGRESS, 2=CAL_STATE_COMPLETE, 3=CAL_STATE_FAILED_ANGLE_INVALID, 4=CAL_STATE_FAILED_IMPROPER_COL_TRQ, 5=CAL_STATE_FAILED_IMPROPER_COL_VEL, 6=CAL_STATE_FAILED_NVM_WRITE
  impl type tCalibrateState: category=VALUE, base-type=sint32, compu-method=tCalibrateState_Compu
  compu method tQualityFactor_Compu: 0=QF_UNINITIALIZED, 0=QF_UNINITIALISED, 1=QF_UNAVAILABLE, 2=QF_DEGRADED, 3=QF_FULL
  impl type tQualityFactor: category=VALUE, base-type=sint32, compu-method=tQualityFactor_Compu
  unit Kph_Unit: display-name=Kph
  impl type Kph: implementation-data-type=Float32
  impl type tRawVehicleSpeed: category=STRUCTURE
    element Value: implementation-data-type=Kph
    element Qf: implementation-data-type=tQualityFactor
  unit Volts_Unit: display-name=V
  impl type Volts: implementation-data-type=Float32
  unit Amps_Unit: display-name=A
  impl type Amps: implementation-data-type=Float32
  unit Nm_Unit: display-name=Nm
  impl type Nm: implementation-data-type=Float32
  unit NmPerSec_Unit: display-name=Nm/s
  impl type NmPerSec: implementation-data-type=Float32
  impl type tRedundancyLevel: implementation-data-type=UInt8
  impl type tExtendedQf: category=STRUCTURE
    4 x element, all with category=TYPE_REFERENCE:
      IntegrityDegraded: implementation-data-type=Boolean
      ResolutionDegraded: implementation-data-type=Boolean
      Defaulted: implementation-data-type=Boolean
      RedundancyLevel: implementation-data-type=tRedundancyLevel
  impl type tInputTorque: category=STRUCTURE
    4 x element, all with category=TYPE_REFERENCE:
      Value: implementation-data-type=Nm
      Derivative: implementation-data-type=NmPerSec
      Qf: implementation-data-type=tQualityFactor
      EQf: implementation-data-type=tExtendedQf
  unit Degrees_Unit: display-name=deg
  impl type Degrees: implementation-data-type=Float32
  impl type tColumnPosition: category=STRUCTURE
    element Value: implementation-data-type=Degrees
    element Qf: implementation-data-type=tQualityFactor
    element EQf: implementation-data-type=tExtendedQf
  unit RevsPerSec_Unit: display-name=revs/S
  impl type RevsPerSec: implementation-data-type=Float32
  impl type tColumnVelocity: category=STRUCTURE
    element Filtered: implementation-data-type=RevsPerSec
    element Unfiltered: implementation-data-type=RevsPerSec
    element Qf: implementation-data-type=tQualityFactor
  impl type tVehicleSpd: category=STRUCTURE
    element Filtered: implementation-data-type=Kph
    element Moving: implementation-data-type=Boolean
    element Qf: implementation-data-type=tQualityFactor
  unit Percent_Unit: display-name=%
  impl type Percent: implementation-data-type=Float32
  impl type tEstimatedSteeringPosition: category=STRUCTURE
    element Value: implementation-data-type=Degrees
    element Qf: implementation-data-type=tQualityFactor
    element Confidence: implementation-data-type=Percent
  unit DegreesPerSec_Unit: display-name=deg/S
  impl type DegreesPerSec: implementation-data-type=Float32
  impl type tYawRateData: category=STRUCTURE
    element Value: implementation-data-type=DegreesPerSec
    element Qf: implementation-data-type=tQualityFactor
  unit uSec_Unit: display-name=uS
  impl type uSec: implementation-data-type=UInt32
  unit Centigrade_Unit: display-name=degs C
  impl type Centigrade: implementation-data-type=Float32
  impl type tSensorAngle: category=STRUCTURE
    element Value: implementation-data-type=Degrees
    element Qf: implementation-data-type=tQualityFactor
  impl type tExternalSignConvention: category=VALUE, base-type=sint32, compu {-1=ISO_SIGN_COVENTION, 1=SAE_SIGN_CONVENTION}
  impl type tZfPartNumber: category=ARRAY
    element Element: array-size=32, array-size-semantics=FIXED-SIZE, implementation-data-type=UInt8
  impl type tZfPartNumberData: category=STRUCTURE
    element PartNumber: implementation-data-type=tZfPartNumber
  compu method tEcuResetType_Compu: 0=ECU_NO_RESET_REQUESTED, 1=ECU_RESET, 2=ECU_RESET_DOWNLOAD, 3=ECU_JUMP_TO_BOOT
  impl type tEcuResetType: category=VALUE, base-type=sint32, compu-method=tEcuResetType_Compu
  impl type tEngineStatus: category=VALUE, base-type=sint32, compu {0=ENGSTS_UNKNOWN, 1=ENGSTS_NOT_RUNNING, 2=ENGSTS_RUNNING}
  impl type tEngineRun: category=STRUCTURE
    element Value: implementation-data-type=tEngineStatus
    element Qf: implementation-data-type=tQualityFactor
  compu method tAssistMode_Compu: 0=ASSIST_INIT, 1=ASSIST_NORMAL_OPERATION, 2=ASSIST_FAIL_OPERATIONAL, 3=ASSIST_LIMP_HOME, 4=ASSIST_LIMP_ASIDE, 5=ASSIST_INOPERATIVE
  impl type tAssistMode: category=VALUE, base-type=sint32, compu-method=tAssistMode_Compu
  impl type tLimitedAssistMode: category=VALUE, base-type=sint32, compu {0=ASSIST_NOT_LIMITED, 1=ASSIST_LIMITED}
  impl type tAssistStates: category=STRUCTURE
    element AssistMode: implementation-data-type=tAssistMode
    element LimitedAssistMode: implementation-data-type=tLimitedAssistMode
  impl type tExtSteerAgDmdSts: category=VALUE, base-type=sint32, compu {0=PA_NO_REQUEST, 1=PA_REQUEST}
  impl type tExtSteerAgDmd: category=STRUCTURE
    4 x element, all with category=TYPE_REFERENCE:
      ReqAg_Value: implementation-data-type=Degrees
      ReqAg_Qf: implementation-data-type=tQualityFactor
      ReqSts_Value: implementation-data-type=tExtSteerAgDmdSts
      ReqSts_Qf: implementation-data-type=tQualityFactor
  impl type tAssistTorque: category=STRUCTURE
    element Value: implementation-data-type=Nm
    element Qf: implementation-data-type=tQualityFactor
  impl type tElectricMotorTorque: category=STRUCTURE
    element Value: implementation-data-type=Nm
    element Qf: implementation-data-type=tQualityFactor
  impl type tMechanicalMotorPosition: category=STRUCTURE
    element Value: implementation-data-type=Degrees
    element Qf: implementation-data-type=tQualityFactor
    element EQf: implementation-data-type=tExtendedQf
  impl type tMechanicalMotorVelocity: category=STRUCTURE
    element Value: implementation-data-type=DegreesPerSec
    element Qf: implementation-data-type=tQualityFactor
    element EQf: implementation-data-type=tExtendedQf
  impl type tAssistCapability: category=STRUCTURE
    element Limit: implementation-data-type=Percent
    element Scale: implementation-data-type=Percent
  impl type NvM_ServiceIdType: implementation-data-type=UInt8
  unit Sec_Unit: display-name=s
  impl type Sec: implementation-data-type=Float32
package /FoundationPkg/FoundationArchitecturePkg/FoundationTypes/ApplicationTypesPkg
  7 x app type, all with category=VALUE:
    tCalibrateCmd: base-type=sint32, compu {0=CAL_NO_COMMAND, 1=CAL_CALIBRATE, 2=CAL_ERASE}  # Calibration command - calibrate or erase.
    Boolean
    tCalibrateState: base-type=sint32, compu-method=tCalibrateState_Compu
    Float32
    tQualityFactor: base-type=sint32, compu-method=tQualityFactor_Compu  # Describes the quality of an input signal.
    UInt8
    Kph_0_to_400: compu {phys=raw for raw 0..400; unit Kph}, range phys 0..400, unit=Kph
  application record data type tRawVehicleSpeed: category=STRUCTURE
    application record element Value: category=VALUE, type=Kph_0_to_400
    application record element Qf: category=VALUE, type=tQualityFactor
  6 x app type, all with category=VALUE:
    Kph: compu {phys=raw for raw -INF..INF; unit Kph}, unit=Kph
    Volts: compu {phys=raw for raw -INF..INF; unit V}, unit=V
    Amps: compu {phys=raw for raw -INF..INF; unit A}, unit=A
    Nm: compu {phys=raw for raw -10..10; unit Nm}, range phys -10..10, unit=Nm
    NmPerSec: compu {phys=raw for raw -2048..2048; unit Nm/s}, range phys -2048..2048, unit=Nm/s  # Rate of change of torque
    tRedundancyLevel: range phys 1..7  # Type used for attributes indicating a level of redundancy of some signal. i.e. could be used to indicate the number of failures required before the signal would become degraded in some way. Thus : 1 : degradation of the signal upon next failure 2 : degradation of the signal upon next 2 failures 3 : degradation of the signal upon next 3 failures and so on.
  application record data type tExtendedQf: category=STRUCTURE  # Extended quality information for a signal, used in conjunction with tQualityFactor. Legal combinations are: Qf = QF_UNINITIALISED, QF_UNINITIALIZED: eQf should be ignored. Qf = QF_UNAVAILABLE: eQf should be ignored. Qf = QF_DEGRADED: eQf - may have any combination of LossOfIntegrity, ResolutionDegraded or Defaulted set to True, and any Redundancy Level. Qf = QF_FULL: eQf Redundancy Level is the only parameter which may be used (LossOfIntegrity, ResolutionDegraded, Defaulted to be ignored).
    4 x application record element, all with category=VALUE:
      IntegrityDegraded: type=Boolean
      ResolutionDegraded: type=Boolean
      Defaulted: type=Boolean
      RedundancyLevel: type=tRedundancyLevel
  application record data type tInputTorque: category=STRUCTURE
    4 x application record element:
      Value: category=VALUE, type=Nm
      Derivative: category=VALUE, type=NmPerSec
      Qf: category=VALUE, type=tQualityFactor
      EQf: category=STRUCTURE, type=tExtendedQf
  app type Degrees_n720_0_to_720_0_res0_1: category=VALUE, compu {phys=raw for raw -720..720; unit deg}, range phys -720..720, display-format=%.1f, unit=deg
  application record data type tColumnPosition: category=STRUCTURE  # Measument of the Column position in degrees with range -720 - +720.
    application record element Value: category=VALUE, type=Degrees_n720_0_to_720_0_res0_1
    application record element Qf: category=VALUE, type=tQualityFactor
    application record element EQf: category=STRUCTURE, type=tExtendedQf
  app type Degrees: category=VALUE, compu {phys=raw for raw -INF..INF; unit deg}, unit=deg
  app type RevsPerSec: category=VALUE, compu {phys=raw for raw -INF..INF; unit revs/S}, unit=revs/S
  application record data type tColumnVelocity: category=STRUCTURE
    application record element Filtered: category=VALUE, type=RevsPerSec
    application record element Unfiltered: category=VALUE, type=RevsPerSec
    application record element Qf: category=VALUE, type=tQualityFactor
  application record data type tVehicleSpd: category=STRUCTURE
    application record element Filtered: category=VALUE, type=Kph_0_to_400
    application record element Moving: category=VALUE, type=Boolean
    application record element Qf: category=VALUE, type=tQualityFactor
  app type Percent: category=VALUE, compu {phys=raw for raw 0..100; unit %}, range phys 0..100, unit=%
  application record data type tEstimatedSteeringPosition: category=STRUCTURE
    application record element Value: category=VALUE, type=Degrees_n720_0_to_720_0_res0_1
    application record element Qf: category=VALUE, type=tQualityFactor
    application record element Confidence: category=VALUE, type=Percent
  app type DegreesPerSec: category=VALUE, compu {phys=raw for raw -INF..INF; unit deg/S}, unit=deg/S
  application record data type tYawRateData: category=STRUCTURE
    application record element Value: category=VALUE, type=DegreesPerSec
    application record element Qf: category=VALUE, type=tQualityFactor
  4 x app type, all with category=VALUE:
    uSec: compu {phys=raw for raw -INF..INF; unit uS}, unit=uS
    UInt32
    Centigrade: compu {phys=raw for raw -INF..INF; unit degs C}, unit=degs C
    Degrees_n900_0_to_900_0_res0_1: compu {phys=raw for raw -900..900; unit deg}, range phys -900..900, display-format=%.1f, unit=deg
  application record data type tSensorAngle: category=STRUCTURE
    application record element Value: category=VALUE, type=Degrees_n900_0_to_900_0_res0_1
    application record element Qf: category=VALUE, type=tQualityFactor
  app type tExternalSignConvention: category=VALUE, base-type=sint32, compu {-1=ISO_SIGN_COVENTION, 1=SAE_SIGN_CONVENTION}
  application array data type tZfPartNumber: category=ARRAY  # Defines the storage of ZF part numbers.
    element Element: category=VALUE, type=UInt8, array-size-semantics=FIXED-SIZE, max-number-of-elements=32
  application record data type tZfPartNumberData: category=STRUCTURE  # Wrapper structure for PartNumber array. Note - the array needs to be wrapped in order that clients calling server operations with PartNumber arguments, can use the type size for memory space allocation.
    application record element PartNumber: category=ARRAY, type=tZfPartNumber
  app type tEcuResetType: category=VALUE, base-type=sint32, compu-method=tEcuResetType_Compu  # Defines the ECU reset modes which can be requested
  app type tEngineStatus: category=VALUE, base-type=sint32, compu {0=ENGSTS_UNKNOWN, 1=ENGSTS_NOT_RUNNING, 2=ENGSTS_RUNNING}
  application record data type tEngineRun: category=STRUCTURE
    application record element Value: category=VALUE, type=tEngineStatus
    application record element Qf: category=VALUE, type=tQualityFactor
  app type UInt16: category=VALUE
  app type tAssistMode: category=VALUE, base-type=sint32, compu-method=tAssistMode_Compu  # State values reported by the Assist Mode Controller
  app type tLimitedAssistMode: category=VALUE, base-type=sint32, compu {0=ASSIST_NOT_LIMITED, 1=ASSIST_LIMITED}  # Indication of whether the assist state is at full capability or being limited.
  application record data type tAssistStates: category=STRUCTURE
    application record element AssistMode: category=VALUE, type=tAssistMode
    application record element LimitedAssistMode: category=VALUE, type=tLimitedAssistMode
  app type tExtSteerAgDmdSts: category=VALUE, base-type=sint32, compu {0=PA_NO_REQUEST, 1=PA_REQUEST}
  application record data type tExtSteerAgDmd: category=STRUCTURE
    4 x application record element, all with category=VALUE:
      ReqAg_Value: type=Degrees
      ReqAg_Qf: type=tQualityFactor
      ReqSts_Value: type=tExtSteerAgDmdSts
      ReqSts_Qf: type=tQualityFactor
  app type Nm_n255_0_to_255_0_res0_1: category=VALUE, compu {phys=raw for raw -255..255; unit Nm}, range phys -255..255, display-format=%.1f, unit=Nm
  application record data type tAssistTorque: category=STRUCTURE
    application record element Value: category=VALUE, type=Nm_n255_0_to_255_0_res0_1
    application record element Qf: category=VALUE, type=tQualityFactor
  application record data type tElectricMotorTorque: category=STRUCTURE
    application record element Value: category=VALUE, type=Nm
    application record element Qf: category=VALUE, type=tQualityFactor
  app type Degrees_n29520_to_29520_res1: category=VALUE, compu {phys=raw for raw -29520..29520; unit deg}, range phys -29520..29520, display-format=%.1f, unit=deg
  application record data type tMechanicalMotorPosition: category=STRUCTURE
    application record element Value: category=VALUE, type=Degrees_n29520_to_29520_res1
    application record element Qf: category=VALUE, type=tQualityFactor
    application record element EQf: category=STRUCTURE, type=tExtendedQf
  app type DegreesPerSec_n47970_to_47970_res1_5: category=VALUE, compu {phys=raw for raw -47970..47970; unit deg/S}, range phys -47970..47970, display-format=%.1f, unit=deg/S
  application record data type tMechanicalMotorVelocity: category=STRUCTURE
    application record element Value: category=VALUE, type=DegreesPerSec_n47970_to_47970_res1_5
    application record element Qf: category=VALUE, type=tQualityFactor
    application record element EQf: category=STRUCTURE, type=tExtendedQf
  application record data type tAssistCapability: category=STRUCTURE
    application record element Limit: category=VALUE, type=Percent
    application record element Scale: category=VALUE, type=Percent
  8 x app type, all with category=VALUE:
    NvM_ServiceIdType
    Kph_0_0_to_400_0: compu {phys=raw for raw 0..400; unit Kph}, range phys 0..400, unit=Kph
    Volts_16_0_to_30_0: compu {phys=raw for raw 16..30; unit V}, range phys 16..30, unit=V
    Volts_9_0_to_10_0: compu {phys=raw for raw 9..10; unit V}, range phys 9..10, unit=V
    Volts_6_5_to_9_0: compu {phys=raw for raw 6.5..9; unit V}, range phys 6.5..9, unit=V
    Volts_5_9_to_6_5: compu {phys=raw for raw 5.9..6.5; unit V}, range phys 5.9..6.5, unit=V
    Volts_0_1_to_5_9: compu {phys=raw for raw 0.1..5.9; unit V}, range phys 0.1..5.9, unit=V
    Sec_0_1_to_5_0: compu {phys=raw for raw 0.1..5; unit s}, range phys 0.1..5, unit=s
package /DataTypeMappingSets
  data type mapping set MappingSet
    data-type-maps:
      application-data-type=tCalibrateCmd, implementation-data-type=tCalibrateCmd
      application-data-type=Boolean, implementation-data-type=Boolean
      application-data-type=tCalibrateState, implementation-data-type=tCalibrateState
      application-data-type=Float32, implementation-data-type=Float32
      application-data-type=RevsPerMin, implementation-data-type=RevsPerMin
      application-data-type=tQualityFactor, implementation-data-type=tQualityFactor
      application-data-type=tEngineSpeed, implementation-data-type=tEngineSpeed
      application-data-type=tPowertrainCrankActiveData, implementation-data-type=tPowertrainCrankActiveData
      application-data-type=tEngine12VSMCmdOnData, implementation-data-type=tEngine12VSMCmdOnData
      application-data-type=UInt8, implementation-data-type=UInt8
      application-data-type=Kph_0_to_400, implementation-data-type=Kph
      application-data-type=Kph, implementation-data-type=Kph
      application-data-type=tRawVehicleSpeed, implementation-data-type=tRawVehicleSpeed
      application-data-type=Volts, implementation-data-type=Volts
      application-data-type=Amps, implementation-data-type=Amps
      application-data-type=tSystemPowerMode, implementation-data-type=tSystemPowerMode
      application-data-type=tSysPwrMd, implementation-data-type=tSysPwrMd
      application-data-type=Nm, implementation-data-type=Nm
      application-data-type=NmPerSec, implementation-data-type=NmPerSec
      application-data-type=tRedundancyLevel, implementation-data-type=tRedundancyLevel
      application-data-type=tExtendedQf, implementation-data-type=tExtendedQf
      application-data-type=tInputTorque, implementation-data-type=tInputTorque
      application-data-type=Degrees_n720_0_to_720_0_res0_1, implementation-data-type=Degrees
      application-data-type=Degrees, implementation-data-type=Degrees
      application-data-type=tColumnPosition, implementation-data-type=tColumnPosition
      application-data-type=RevsPerSec, implementation-data-type=RevsPerSec
      application-data-type=tColumnVelocity, implementation-data-type=tColumnVelocity
      application-data-type=tVehicleSpd, implementation-data-type=tVehicleSpd
      application-data-type=Percent, implementation-data-type=Percent
      application-data-type=tEstimatedSteeringPosition, implementation-data-type=tEstimatedSteeringPosition
      application-data-type=DegreesPerSec, implementation-data-type=DegreesPerSec
      application-data-type=tYawRateData, implementation-data-type=tYawRateData
      application-data-type=UInt32, implementation-data-type=UInt32
      application-data-type=uSec, implementation-data-type=uSec
      application-data-type=Centigrade, implementation-data-type=Centigrade
      application-data-type=Degrees_n900_0_to_900_0_res0_1, implementation-data-type=Degrees
      application-data-type=tSensorAngle, implementation-data-type=tSensorAngle
      application-data-type=tPamState, implementation-data-type=tPamState
      application-data-type=tExternalSignConvention, implementation-data-type=tExternalSignConvention
      application-data-type=tZfPartNumber, implementation-data-type=tZfPartNumber
      application-data-type=tZfPartNumberData, implementation-data-type=tZfPartNumberData
      application-data-type=tEcuResetType, implementation-data-type=tEcuResetType
      application-data-type=tEngineStatus, implementation-data-type=tEngineStatus
      application-data-type=tEngineRun, implementation-data-type=tEngineRun
      application-data-type=UInt16, implementation-data-type=UInt16
      application-data-type=tAssistMode, implementation-data-type=tAssistMode
      application-data-type=tLimitedAssistMode, implementation-data-type=tLimitedAssistMode
      application-data-type=tAssistStates, implementation-data-type=tAssistStates
      application-data-type=tExtSteerAgDmdSts, implementation-data-type=tExtSteerAgDmdSts
      application-data-type=tExtSteerAgDmd, implementation-data-type=tExtSteerAgDmd
      application-data-type=Nm_n255_0_to_255_0_res0_1, implementation-data-type=Nm
      application-data-type=tAssistTorque, implementation-data-type=tAssistTorque
      application-data-type=tElectricMotorTorque, implementation-data-type=tElectricMotorTorque
      application-data-type=Degrees_n29520_to_29520_res1, implementation-data-type=Degrees
      application-data-type=tMechanicalMotorPosition, implementation-data-type=tMechanicalMotorPosition
      application-data-type=DegreesPerSec_n47970_to_47970_res1_5, implementation-data-type=DegreesPerSec
      application-data-type=tMechanicalMotorVelocity, implementation-data-type=tMechanicalMotorVelocity
      application-data-type=tAssistCapability, implementation-data-type=tAssistCapability
      application-data-type=tRemoteProgrammingState, implementation-data-type=tRemoteProgrammingState
      application-data-type=NvM_ServiceIdType, implementation-data-type=NvM_ServiceIdType
      application-data-type=tStrWhAngGrd, implementation-data-type=tStrWhAngGrd
      application-data-type=tStrWhAngSenCalStat, implementation-data-type=tStrWhAngSenCalStat
      application-data-type=tStrWhAngMsk, implementation-data-type=tStrWhAngMsk
      application-data-type=tStrWhAng, implementation-data-type=tStrWhAng
      application-data-type=tMecNvRamBlockSize, implementation-data-type=tMecNvRamBlockSize
      application-data-type=tMecDataStoreNvm, implementation-data-type=tMecDataStoreNvm
      application-data-type=tSbaTicketNvRamBlockSize, implementation-data-type=tSbaTicketNvRamBlockSize
      application-data-type=tSBINvmDataBlock, implementation-data-type=tSBINvmDataBlock
      application-data-type=tSbaTicketDataStoreNvm, implementation-data-type=tSbaTicketDataStoreNvm
      application-data-type=tProgDateNvmDataBlock, implementation-data-type=tProgDateNvmDataBlock
      application-data-type=tProgramDateDataStoreNvm, implementation-data-type=tProgramDateDataStoreNvm
      application-data-type=tVppsNvRamBlockSize, implementation-data-type=tVppsNvRamBlockSize
      application-data-type=tVppsDataStoreNvm, implementation-data-type=tVppsDataStoreNvm
      application-data-type=tDunsNvRamBlockSize, implementation-data-type=tDunsNvRamBlockSize
      application-data-type=tDunsDataStoreNvm, implementation-data-type=tDunsDataStoreNvm
      application-data-type=tMtcNvRamBlockSize, implementation-data-type=tMtcNvRamBlockSize
      application-data-type=tMtcDataStoreNvm, implementation-data-type=tMtcDataStoreNvm
      application-data-type=tInitialReflashFlagStoreNvm, implementation-data-type=tInitialReflashFlagStoreNvm
      application-data-type=tGM_EmpnNvRamBlockSize, implementation-data-type=tGM_EmpnNvRamBlockSize
      application-data-type=tGM_NvmProvided, implementation-data-type=tGM_NvmProvided
      application-data-type=tEmpnDataStoreNvm, implementation-data-type=tEmpnDataStoreNvm
      application-data-type=tGM_EmpnacNvRamBlockSize, implementation-data-type=tGM_EmpnacNvRamBlockSize
      application-data-type=tEmpnacDataStoreNvm, implementation-data-type=tEmpnacDataStoreNvm
      application-data-type=tGM_MacBypassNvRamBlockSize, implementation-data-type=tGM_MacBypassNvRamBlockSize
      application-data-type=tMacBypassDataStoreNvm, implementation-data-type=tMacBypassDataStoreNvm
      application-data-type=tGM_SaBypassNvRamBlockSize, implementation-data-type=tGM_SaBypassNvRamBlockSize
      application-data-type=tSaBypassDataStoreNvm, implementation-data-type=tSaBypassDataStoreNvm
      application-data-type=tCurrentRSCOTSN_NvRamBlockSize, implementation-data-type=tCurrentRSCOTSN_NvRamBlockSize
      application-data-type=tCurrentRSCOTSNDataStoreNvm, implementation-data-type=tCurrentRSCOTSNDataStoreNvm
      application-data-type=tSecondLastRSCOTSN_NvRamBlockSize, implementation-data-type=tSecondLastRSCOTSN_NvRamBlockSize
      application-data-type=tSecondLastRSCOTSNDataStoreNvm, implementation-data-type=tSecondLastRSCOTSNDataStoreNvm
      application-data-type=tLastRSCOTSN_NvRamBlockSize, implementation-data-type=tLastRSCOTSN_NvRamBlockSize
      application-data-type=tLastRSCOTSNDataStoreNvm, implementation-data-type=tLastRSCOTSNDataStoreNvm
      application-data-type=tStrgMotorOvldProtInc_NvRamBlockSize, implementation-data-type=tStrgMotorOvldProtInc_NvRamBlockSize
      application-data-type=tStrgMotorOvldProtIncDataStoreNvm, implementation-data-type=tStrgMotorOvldProtIncDataStoreNvm
      application-data-type=tOvldProtPast50IgnCycles_NvRamBlockSize, implementation-data-type=tOvldProtPast50IgnCycles_NvRamBlockSize
      application-data-type=tOvldProtPast50IgnCyclesDataStoreNvm, implementation-data-type=tOvldProtPast50IgnCyclesDataStoreNvm
      application-data-type=tRemProgStateNvm, implementation-data-type=tRemProgStateNvm
      application-data-type=tCommControlStatusSID28, implementation-data-type=tCommControlStatusSID28
      application-data-type=tCgdNvmJobStatus, implementation-data-type=tCgdNvmJobStatus
      application-data-type=Kph_0_0_to_400_0, implementation-data-type=Kph
      application-data-type=Volts_16_0_to_30_0, implementation-data-type=Volts
      application-data-type=Volts_9_0_to_10_0, implementation-data-type=Volts
      application-data-type=Volts_6_5_to_9_0, implementation-data-type=Volts
      application-data-type=Volts_5_9_to_6_5, implementation-data-type=Volts
      application-data-type=Volts_0_1_to_5_9, implementation-data-type=Volts
      application-data-type=Sec_0_1_to_5_0, implementation-data-type=Sec
package /SwAddrMethods
  8 x sw addr method, all with memory-allocation-keyword-policy=ADDR-METHOD-SHORT-NAME, section-type=CALIBRATION-ONLINE:
    VehicleTune
    PlatformTune
    DevelopmentTune
    SteeringTune
    SensorTune
    EppTune
    GearTune
    FeatureTune
package /GeneralMotorsPkg/GeneralMotorsArchitecturePkg
  constant specification iMecData_MEC_Init: value-spec=254
  sender receiver interface iMecData
    data MEC: sw-calibration-access=READ-ONLY, type=SUM_DIAG_MEC_Type, init-value=constant-reference=iMecData_MEC_Init
  constant specification iEcuAddress_ECUAddress_Init: value-spec=[0x43, 0x41, 0x4e, 0x4, 0x45, 0x20, 0x44, 0x49, 0x56, 0x41, 0x20, 0x45, 0x43, 0x55, 0x49, 0x44]
  sender receiver interface iEcuAddress
    data ECUAddress: sw-calibration-access=READ-ONLY, type=SUM_SSC_16ByteArray, init-value=constant-reference=iEcuAddress_ECUAddress_Init
  constant specification iEngRunAtv_EngineSpeed_Init: value-spec={short-label=iEngRunAtv_EngineSpeed_Init, fields=[0 rpm, 0]}
  constant specification iEngRunAtv_PowertrainCrankActive_Init: value-spec={short-label=iEngRunAtv_PowertrainCrankActive_Init, fields=[0, 0]}
  constant specification iEngRunAtv_Engine12VStarterMotorCmdOn_Init: value-spec={short-label=iEngRunAtv_Engine12VStarterMotorCmdOn_Init, fields=[0, 0]}
  sender receiver interface iEngRunAtv
    data EngineSpeed: sw-calibration-access=READ-ONLY, type=tEngineSpeed, init-value=constant-reference=iEngRunAtv_EngineSpeed_Init
    data PowertrainCrankActive: sw-calibration-access=READ-ONLY, type=tPowertrainCrankActiveData, init-value=constant-reference=iEngRunAtv_PowertrainCrankActive_Init
    data Engine12VStarterMotorCmdOn: sw-calibration-access=READ-ONLY, type=tEngine12VSMCmdOnData, init-value=constant-reference=iEngRunAtv_Engine12VStarterMotorCmdOn_Init
  constant specification iXcpData_XcpStatus_Init: value-spec=1
  sender receiver interface iXcpData
    data XcpStatus: sw-calibration-access=READ-ONLY, type=UInt8, init-value=constant-reference=iXcpData_XcpStatus_Init
  client server interface iGmCgdControl
    operation performFastShutdown
  constant specification iSumSscInitialReflashFlag_InitialReflashFlag_Init: value-spec=0
  sender receiver interface iSumSscInitialReflashFlag
    data InitialReflashFlag: sw-calibration-access=READ-ONLY, type=Boolean, init-value=constant-reference=iSumSscInitialReflashFlag_InitialReflashFlag_Init
  client server interface iDcmSessionChange
    operation SessionChange
  constant specification iSysPwrMd_SysPwrMd_Init: value-spec={short-label=iSysPwrMd_SysPwrMd_Init, fields=[0, 0]}
  sender receiver interface iSysPwrMd
    data SysPwrMd: sw-calibration-access=READ-ONLY, type=tSysPwrMd, init-value=constant-reference=iSysPwrMd_SysPwrMd_Init
  constant specification iPamState_PamState_Init: value-spec=0
  sender receiver interface iPamState
    data PamState: sw-calibration-access=READ-ONLY, type=tPamState, init-value=constant-reference=iPamState_PamState_Init
  client server interface iPerformShutdownActions
    operation performShutdownAction
  constant specification iSumSscPropulsionActiveIf_PropulsionSystemActive_Init: value-spec=0
  sender receiver interface iSumSscPropulsionActiveIf
    data PropulsionSystemActive: sw-calibration-access=READ-ONLY, type=Boolean, init-value=constant-reference=iSumSscPropulsionActiveIf_PropulsionSystemActive_Init
  constant specification iSumSscVehicleSpeedIf_VehicleSpeed_Init: value-spec=0
  sender receiver interface iSumSscVehicleSpeedIf
    data VehicleSpeed: sw-calibration-access=READ-ONLY, type=UInt16, init-value=constant-reference=iSumSscVehicleSpeedIf_VehicleSpeed_Init
  constant specification iRemoteProgrammingState_RemoteProgrammingState_Init: value-spec={short-label=iRemoteProgrammingState_RemoteProgrammingState_Init, fields=[0, 0]}
  sender receiver interface iRemoteProgrammingState
    data RemoteProgrammingState: sw-calibration-access=READ-ONLY, type=tRemoteProgrammingState, init-value=constant-reference=iRemoteProgrammingState_RemoteProgrammingState_Init
  constant specification iProgStateRequest_ProgState_Init: value-spec=0
  sender receiver interface iProgStateRequest
    data ProgState: sw-calibration-access=READ-ONLY, type=Boolean, init-value=constant-reference=iProgStateRequest_ProgState_Init
  constant specification iSumSscStrWhAngGrd_SUM_SSC_StrWhAngGrd_Init: value-spec=0
  sender receiver interface iSumSscStrWhAngGrd
    data SUM_SSC_StrWhAngGrd: sw-calibration-access=READ-ONLY, type=tStrWhAngGrd, init-value=constant-reference=iSumSscStrWhAngGrd_SUM_SSC_StrWhAngGrd_Init
  constant specification iSumSscStrWhlAngSenCalStat_SUM_SSC_StrWhlAngSenCalStat_Init: value-spec=0
  sender receiver interface iSumSscStrWhlAngSenCalStat
    data SUM_SSC_StrWhlAngSenCalStat: sw-calibration-access=READ-ONLY, type=tStrWhAngSenCalStat, init-value=constant-reference=iSumSscStrWhlAngSenCalStat_SUM_SSC_StrWhlAngSenCalStat_Init
  constant specification iSumSscStrWhAngMsk_SUM_SSC_StrWhAngMsk_Init: value-spec=0
  sender receiver interface iSumSscStrWhAngMsk
    data SUM_SSC_StrWhAngMsk: sw-calibration-access=READ-ONLY, type=tStrWhAngMsk, init-value=constant-reference=iSumSscStrWhAngMsk_SUM_SSC_StrWhAngMsk_Init
  constant specification iSumSscStrWhAng_SUM_SSC_StrWhAng_Init: value-spec=0
  sender receiver interface iSumSscStrWhAng
    data SUM_SSC_StrWhAng: sw-calibration-access=READ-ONLY, type=tStrWhAng, init-value=constant-reference=iSumSscStrWhAng_SUM_SSC_StrWhAng_Init
